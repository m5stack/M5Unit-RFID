/*
 * SPDX-FileCopyrightText: 2024 M5Stack Technology CO LTD
 *
 * SPDX-License-Identifier: MIT
 */
/*
  Example using M5UnitUnified for UnitRFID2
  NFC read/write example for UltraLight/C,NTAG
*/
#include <M5Unified.h>
#include <M5UnitUnified.h>
#include <M5UnitUnifiedRFID.h>
#include <M5Utility.h>
#include <vector>

namespace {
auto& lcd = M5.Display;
m5::unit::UnitUnified Units;
m5::unit::UnitRFID2 unit;

}  // namespace

using namespace m5::unit::mfrc522;
using namespace m5::rfid;
using namespace m5::rfid::nfc::ndef;

void setup()
{
    M5.begin();

    auto pin_num_sda = M5.getPin(m5::pin_name_t::port_a_sda);
    auto pin_num_scl = M5.getPin(m5::pin_name_t::port_a_scl);
    M5_LOGI("getPin: SDA:%u SCL:%u", pin_num_sda, pin_num_scl);
    Wire.begin(pin_num_sda, pin_num_scl, 100 * 1000U);

    if (!Units.add(unit, Wire) || !Units.begin()) {
        M5_LOGE("Failed to begin");
        lcd.clear(TFT_RED);
        while (true) {
            m5::utility::delay(10000);
        }
    }

    M5_LOGI("M5UnitUnified has been begun");
    M5_LOGI("%s", Units.debugInfo().c_str());

    if (lcd.width() < lcd.height()) {
        lcd.setRotation(1);
    }
    if (lcd.height() < 240) {
        lcd.setFont(&fonts::Font0);
    } else {
        lcd.setFont(&fonts::Font2);
    }
    lcd.clear(0);
    lcd.setCursor(8, 0);
    lcd.printf("Please put the devices");
    M5_LOGI("Please put the devices");
}

void nfc_read(const UID& uid)
{
    uint8_t rbuf[1024]{};
    uint32_t sz{};

    if (!unit.mifareRequiredSizeNDEF(uid, sz)) {
        M5_LOGE("Failed to read");
        return;
    }
    M5_LOGI("Required size:%u", sz);

    if (sz > m5::stl::size(rbuf)) {
        M5_LOGE("Not enough buffer %u", sz);
        return;
    }

    lcd.clear();
    lcd.setCursor(0, lcd.fontHeight());
    lcd.printf("UID:%s %s\n", uid.uidAsString().c_str(), uid.typeAsString().c_str());

    auto result = unit.mifareReadNDEF(uid, rbuf, sz);
    if (!result) {
        M5_LOGE("Failed to read %02X", result.error());
        return;
    }
    M5_LOGI("Read:%u", sz);
    // M5_DUMPI(rbuf, sz);

    uint32_t offset{};
    Message msg{};
    do {
        auto decoded = msg.decode(rbuf + offset, sz - offset);
        if (!decoded) {
            M5_LOGE("Failed to decode");
            break;
        }
        offset += decoded;
        M5_LOGI("Decoded:%u", decoded);

        msg.dump();

        if (msg.isNDEFMessage()) {
            for (auto&& r : msg.records()) {
                if (r.tnf() == TNF::Wellknown) {
                    auto s = r.payloadAsString().c_str();
                    M5_LOGI("R:%u TNF:%u T:%s [%s]", r.required(), r.tnf(), r.type(), s);
                    lcd.printf("T:%s [%s]\n", r.type(), s);
                }
            }
        }
    } while (!msg.isTerminator());
}

void nfc_write(const UID& uid)
{
    Message msg{};      // NDEFMessage as default
    Record r0{}, r1{};  // Wellknown as default

    // URI Record
    r0.setURIPayload("https://m5stack.com/", URIProtocol::HTTPS);

    // Text Reacord (need langage type)
    // const char* en_data = "Hello M5Stack";
    // r1.setTextPayload(en_data, "en");
    // const char* ja_data = "こんにちは M5Stack";
    // r1.setTextPayload(ja_data, "ja");
    const char* zh_data = "你好 M5Stack";
    r1.setTextPayload(zh_data, "zh");

    msg.push_back(r0);
    msg.push_back(r1);

    // Encode
    uint8_t buf[1024]{};
    if (msg.required() > m5::stl::size(buf)) {
        M5_LOGE("Not enough buffer");
        return;
    }
    auto encoded = msg.encode(buf, m5::stl::size(buf));
    if (encoded == 0) {
        M5_LOGE("Failed to encode");
        return;
    }

    M5_LOGI("Write length: %u", encoded);
    // M5_DUMPI(buf, encoded);

    // Write (and Change formatif  UltraLight/C)
    // true if NATG or NTAG format Light/C already exists
    if (unit.mifareWriteChangeToNTAGFormat(uid)) {
        auto result = unit.mifareWriteNDEF(uid, buf, encoded);
        if (result) {
            M5_LOGI("Write OK");
        } else {
            M5_LOGI("Write NG:%02X", result.error());
        }
    } else {
        M5_LOGE("Failed to changeToNTAGFormat");
    }
}

#if 0
namespace {
// PNG image binary
constexpr uint8_t poji_64_png[] = {
    0x89, 0x50, 0x4e, 0x47, 0x0d, 0x0a, 0x1a, 0x0a, 0x00, 0x00, 0x00, 0x0d, 0x49, 0x48, 0x44, 0x52, 0x00, 0x00, 0x00,
    0x40, 0x00, 0x00, 0x00, 0x40, 0x01, 0x00, 0x00, 0x00, 0x00, 0x82, 0x12, 0x4c, 0x73, 0x00, 0x00, 0x00, 0x02, 0x62,
    0x4b, 0x47, 0x44, 0x00, 0x01, 0xdd, 0x8a, 0x13, 0xa4, 0x00, 0x00, 0x00, 0x09, 0x70, 0x48, 0x59, 0x73, 0x00, 0x00,
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    0x2b, 0x21, 0x59, 0xaa, 0x00, 0x00, 0x00, 0x00, 0x49, 0x45, 0x4e, 0x44, 0xae, 0x42, 0x60, 0x82};

constexpr uint32_t poji_64_png_len = 738;

}  // namespace

// Need large user area (NATG216)
void nfc_write_png(const UID& uid)
{
    Message msg{};
    Record r{TNF::Media};  // using MIME
    r.setType("image/png");
    r.setPayload(poji_64_png, poji_64_png_len);
    msg.push_back(r);

    // Encode
    uint8_t buf[1024]{};
    if (msg.required()  > m5::stl::size(buf)) {
        M5_LOGE("Not enough buffer");
        return;
    }
    auto encoded = msg.encode(buf, m5::stl::size(buf));
    if (encoded == 0) {
        M5_LOGE("Failed to encode");
        return;
    }
    M5_LOGI("Write length: %u", encoded);
    //    M5_DUMPI(buf, encoded);

    if (unit.mifareWriteChangeToNTAGFormat(uid)) {
        auto result = unit.mifareWriteNDEF(uid, buf, encoded);
        if (result) {
            M5_LOGI("Write OK");
        } else {
            M5_LOGI("Write NG:%02X", result.error());
        }
    } else {
        M5_LOGE("Failed to changeToNTAGFormat");
    }
}

#endif

void loop()
{
    M5.update();
    auto touch = M5.Touch.getDetail();

    // Read NFC data
    if (M5.BtnA.wasClicked() || touch.wasClicked()) {
        if (unit.detectIdleDevice()) {
            UID uid{};
            if (unit.activateDevice(uid)) {
                M5.Speaker.tone(1000, 20);
                M5_LOGI("UID:%s %s", uid.uidAsString().c_str(), uid.typeAsString().c_str());

                if (uid.canNFC()) {
                    nfc_read(uid);
                    // unit.dumpDevice(uid);
                } else {
                    M5_LOGE("This device can not support NFC");
                }

                unit.deactivateDevice();
            }
        }
    }
    // Write NFC data
    else if (M5.BtnA.isHolding() || touch.isHolding()) {
        if (unit.detectIdleDevice()) {
            UID uid{};
            if (unit.activateDevice(uid)) {
                if (uid.canNFC()) {
                    M5.Speaker.tone(2000, 20);
                    M5_LOGI("UID:%s %s", uid.uidAsString().c_str(), uid.typeAsString().c_str());

                    nfc_write(uid);
                    // nfc_write_png(uid);
                    //  unit.dumpDevice(uid);

                } else {
                    M5_LOGE("This device can not support NFC");
                }
                unit.deactivateDevice();
            }
        }
    }
}
